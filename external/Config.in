## external/package/dawos-dspbench/Config.in
```kconfig
config BR2_PACKAGE_DAWOS_DSPBENCH
	bool "dawos-dspbench"
	depends on BR2_x86_64
	help
	  A measurement tool, not product code: it times a cascade of
	  second-order filters in AVX2, the kernel of the reference load
	  of requirement R-04 (ADR 0011), on the CPU it is bound to.
	  Experiment E-06 runs it on a performance core and on an
	  efficiency core to measure the ratio between the two.

	  Installs the program as /usr/libexec/dawos/dspbench; the
	  script dawos-dspbench of the root file system overlay runs it.
```

## external/package/dawos-engine/Config.in
```kconfig
config BR2_PACKAGE_DAWOS_ENGINE
	bool "dawos-engine"
	depends on BR2_x86_64
	depends on BR2_PACKAGE_HOST_RUSTC_TARGET_ARCH_SUPPORTS
	select BR2_PACKAGE_HOST_RUSTC
	select BR2_PACKAGE_ALSA_LIB
	select BR2_PACKAGE_ALSA_LIB_PCM
	select BR2_PACKAGE_ALSA_LIB_MIXER
	select BR2_PACKAGE_ALSA_LIB_RAWMIDI
	select BR2_PACKAGE_ALSA_LIB_HWDEP
	select BR2_PACKAGE_ALSA_LIB_SEQ
	help
	  The dawOS audio engine (Phase 1). A Rust workspace kept in
	  this repository, in crates/; built with the Rust compiler
	  Buildroot installs for the build machine and linked with the
	  toolchain of the image.

	  Installs /usr/bin/dawos-engine.

	  The external crates it depends on are not downloaded by the
	  image build: "make engine-vendor" puts them in crates/vendor
	  beforehand, checked against the checksums of Cargo.lock.
```

## external/package/fcp-support/Config.in
```kconfig
config BR2_PACKAGE_FCP_SUPPORT
	bool "fcp-support"
	depends on BR2_INIT_SYSTEMD
	depends on BR2_USE_MMU
	select BR2_PACKAGE_ALSA_LIB
	select BR2_PACKAGE_ALSA_LIB_HWDEP
	select BR2_PACKAGE_ALSA_LIB_MIXER
	select BR2_PACKAGE_JSON_C
	select BR2_PACKAGE_OPENSSL
	select BR2_PACKAGE_ZLIB
	help
	  The user-space half of the Linux support for the Focusrite
	  interfaces that speak the Focusrite Control Protocol: the
	  Scarlett 16i16, 18i16 and 18i20 of the fourth generation and
	  the ISA C8X. The kernel driver (sound/usb/fcp.c, in Linux
	  since 6.14) only carries messages to and from the interface;
	  what they mean is known here.

	  fcp-server, started by udev for each such interface, reads
	  its router, mixer and preamplifier settings and shows them as
	  ALSA controls, the ones dawos-card-setup reads and writes.
	  Without it the interface plays and records, with whatever
	  routing it has in its memory, and nothing can be read or
	  changed.

	  fcp-tool lists the interfaces with the version of their
	  firmware and updates it, from the files of the package
	  scarlett4-firmware.

	  https://github.com/geoffreybennett/fcp-support
```

## external/package/scarlett4-firmware/Config.in
```kconfig
config BR2_PACKAGE_SCARLETT4_FIRMWARE
	bool "scarlett4-firmware"
	depends on BR2_PACKAGE_FCP_SUPPORT
	help
	  The firmware of the Focusrite Scarlett 18i20 of the fourth
	  generation, as Focusrite publishes it for use with Linux: the
	  file fcp-tool writes into the interface when asked to update
	  it. Nothing in the image does so by itself.

	  Only the file of the 18i20 (USB 1235:821d) is installed, in
	  /usr/lib/firmware/scarlett4. It is not free software: it may
	  be passed on unchanged, for use with products of Focusrite
	  only (LICENSE.Focusrite).

	  https://github.com/geoffreybennett/scarlett4-firmware
```
